## config/boards/shields/dactyl_manuform_5x6/Kconfig.shield
```kconfig
config SHIELD_DACTYL_MANUFORM_5X6_LEFT
    bool "dactyl_manuform_5x6_left"
    select ZMK_SPLIT_KEYBOARD

config SHIELD_DACTYL_MANUFORM_5X6_RIGHT
    bool "dactyl_manuform_5x6_right"
    select ZMK_SPLIT_KEYBOARD
```

## config/west.yml
```yaml
manifest:
  remotes:
    - name: zmkfirmware
      url-base: https://github.com/zmkfirmware
  projects:
    - name: zmk
      remote: zmkfirmware
      revision: main
      import: app/west.yml
  self:
    path: config

# manifest:
#   remotes:
#     - name:  zmkfirmware
#       url-base: https://github.com/zmkfirmware
#   projects:
#     - name: zmk
#       remote: zmkfirmware
#       revision: v3.5.1  # or another stable release
#       import: app/west.yml
#   self:
#     path: config
```
